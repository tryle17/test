&actuator_wide {
    pid_version = <0x20>;
    pid_version_verify = <
        'W'  0x02  0x40  0x03

        'R'  0x03  0x1C  0xFF
        'R'  0x16  0x20  0xFF
    >;
    pid_update_setting = <
        'W'  0xAE  0x3B  0x00
        'W'  0x0B  0x82  0x00
        'W'  0x0A  0x00  0x00
        'W'  0x0E  0x8C  0x00
        'W'  0x0F  0xC1  0x00
        'W'  0x08  0x1E  0x00
        'W'  0x09  0x20  0x00
        'W'  0x10  0x35  0x00
        'W'  0x11  0x41  0x00
        'W'  0x12  0x6E  0x00
        'W'  0x13  0x22  0x00
        'W'  0x14  0x14  0x00
        'W'  0x15  0x00  0x00
        'W'  0x16  0x20  0x00
        'W'  0x17  0x3C  0x00
        'W'  0x18  0xAA  0x00
        'W'  0x1A  0x00  0x00
        'W'  0x1B  0x30  0x00
        'W'  0x1C  0xBE  0x00
        'W'  0x1D  0xDC  0x00
        'W'  0x1E  0xE1  0x00
        'W'  0x1F  0x14  0x00
        'W'  0x20  0x21  0x00
        'W'  0x21  0x29  0x00
        'W'  0x22  0x3C  0x00
        'W'  0x23  0xB9  0x00
        'W'  0x24  0x9C  0x00
        'W'  0x25  0x07  0x00
        'W'  0x26  0xC3  0x00
        'W'  0x27  0xBC  0x00
        'W'  0x28  0x7C  0x00
        'W'  0x29  0x0B  0x00
        'W'  0x2A  0x3C  0x00
        'W'  0x2B  0x9A  0x00
        'W'  0x2C  0x84  0x00
        'W'  0x2D  0xC9  0x00
        'W'  0x2E  0x3E  0x00
        'W'  0x2F  0xD6  0x00
        'W'  0x30  0x00  0x00
        'W'  0x31  0x3D  0x00
        'W'  0x32  0x00  0x00
        'W'  0x33  0x28  0x00
        'W'  0x34  0xC0  0x00
        'W'  0x35  0x46  0x00
        'W'  0x36  0xC7  0x00
        'W'  0x3C  0x50  0x00
        'W'  0x3D  0xC5  0x00
        'W'  0x52  0x14  0x00
        'W'  0x53  0x50  0x00
        'W'  0x54  0x14  0x00
        'W'  0x55  0x32  0x00
        'W'  0x50  0x46  0x00
        'W'  0x51  0xD8  0x00
        'W'  0x56  0x23  0x00
        'W'  0x57  0xB4  0x00
        'W'  0x58  0x40  0x00
        'W'  0x59  0x0B  0x00
        'W'  0x5A  0x00  0x00
        'W'  0x5B  0x02  0x00
        'W'  0x5C  0x32  0x00
        'W'  0x5E  0x00  0x00
        'W'  0x5F  0x00  0x00
        'W'  0xC4  0x00  0x00

        'W'  0x03  0x01  0x65
        'W'  0x03  0x02  0xB5
        'W'  0x03  0x04  0x97
        'W'  0x03  0x08  0xA1

        'R'  0x4B  0x00  0x04
        'W'  0xAE  0x00  0x00
    >;
    pid_post_verify = <
        'R'  0x0A  0x00  0xFF
        'R'  0x0E  0x8C  0xFF
        'R'  0x0F  0xC1  0xFF
        'R'  0x08  0x1E  0xFF
        'R'  0x09  0x20  0xFF
        'R'  0x10  0x35  0xFF
        'R'  0x11  0x41  0xFF
        'R'  0x12  0x6E  0xFF
        'R'  0x13  0x22  0xFF
        'R'  0x14  0x14  0xFF
        'R'  0x15  0x00  0xFF
        'R'  0x16  0x20  0xFF
        'R'  0x17  0x3C  0xFF
        'R'  0x18  0xAA  0xFF
        'R'  0x1A  0x00  0xFF
        'R'  0x1B  0x30  0xFF
        'R'  0x1C  0xBE  0xFF
        'R'  0x1D  0xDC  0xFF
        'R'  0x1E  0xE1  0xFF
        'R'  0x1F  0x14  0xFF
        'R'  0x20  0x21  0xFF
        'R'  0x21  0x29  0xFF
        'R'  0x22  0x3C  0xFF
        'R'  0x23  0xB9  0xFF
        'R'  0x24  0x9C  0xFF
        'R'  0x25  0x07  0xFF
        'R'  0x26  0xC3  0xFF
        'R'  0x27  0xBC  0xFF
        'R'  0x28  0x7C  0xFF
        'R'  0x29  0x0B  0xFF
        'R'  0x2A  0x3C  0xFF
        'R'  0x2B  0x9A  0xFF
        'R'  0x2C  0x84  0xFF
        'R'  0x2D  0xC9  0xFF
        'R'  0x2E  0x3E  0xFF
        'R'  0x2F  0xD6  0xFF
        'R'  0x30  0x00  0xFF
        'R'  0x31  0x3D  0xFF
        'R'  0x32  0x00  0xFF
        'R'  0x33  0x28  0xFF
        'R'  0x34  0xC0  0xFF
        'R'  0x35  0x46  0xFF
        'R'  0x36  0xC7  0xFF
        'R'  0x3C  0x50  0xFF
        'R'  0x3D  0xC5  0xFF
        'R'  0x52  0x14  0xFF
        'R'  0x53  0x50  0xFF
        'R'  0x54  0x14  0xFF
        'R'  0x55  0x32  0xFF
        'R'  0x50  0x46  0xFF
        'R'  0x51  0xD8  0xFF
        'R'  0x56  0x23  0xFF
        'R'  0x57  0xB4  0xFF
        'R'  0x58  0x40  0xFF
        'R'  0x59  0x0B  0xFF
        'R'  0x5A  0x00  0xFF
        'R'  0x5B  0x02  0xFF
        'R'  0x5C  0x32  0xFF
        'R'  0x5E  0x00  0xFF
        'R'  0x5F  0x00  0xFF
        'R'  0xC4  0x00  0xFF
    >;

    pid_settings_addr_type = <1>;
    pid_settings_data_type = <1>;
};

&actuator_tele {
    pid_version = <0x10>;
    pid_version_verify = <
        'W'  0x02  0x40  0x03

        'R'  0x03  0x1C  0xFF
        'R'  0x16  0x10  0xFF
    >;
    pid_update_setting = <
        'W'  0xAE  0x3B  0x00
        'W'  0x0B  0x82  0x00
        'W'  0x0A  0x33  0x00
        'W'  0x0E  0x88  0x00
        'W'  0x0F  0xC1  0x00
        'W'  0x08  0x1E  0x00
        'W'  0x09  0x20  0x00
        'W'  0x10  0x4B  0x00
        'W'  0x11  0x52  0x00
        'W'  0x12  0x8A  0x00
        'W'  0x13  0x2B  0x00
        'W'  0x14  0x0C  0x00
        'W'  0x15  0x00  0x00
        'W'  0x16  0x10  0x00
        'W'  0x17  0x40  0x00
        'W'  0x18  0xAA  0x00
        'W'  0x1A  0x00  0x00
        'W'  0x1B  0x66  0x00
        'W'  0x1C  0xC9  0x00
        'W'  0x1D  0xD8  0x00
        'W'  0x1E  0xE9  0x00
        'W'  0x1F  0x1E  0x00
        'W'  0x20  0x1E  0x00
        'W'  0x21  0x42  0x00
        'W'  0x22  0xFB  0x00
        'W'  0x23  0x05  0x00
        'W'  0x24  0xF4  0x00
        'W'  0x25  0xFE  0x00
        'W'  0x26  0xC7  0x00
        'W'  0x27  0xBA  0x00
        'W'  0x28  0x77  0x00
        'W'  0x29  0xE2  0x00
        'W'  0x2A  0x39  0x00
        'W'  0x2B  0xB9  0x00
        'W'  0x2C  0x88  0x00
        'W'  0x2D  0x1E  0x00
        'W'  0x2E  0x3E  0x00
        'W'  0x2F  0x8D  0x00
        'W'  0x30  0x00  0x00
        'W'  0x31  0x34  0x00
        'W'  0x32  0x00  0x00
        'W'  0x33  0xB4  0x00
        'W'  0x34  0x00  0x00
        'W'  0x35  0x96  0x00
        'W'  0x36  0x00  0x00
        'W'  0x3C  0x50  0x00
        'W'  0x3D  0xCD  0x00
        'W'  0x52  0x0F  0x00
        'W'  0x53  0x64  0x00
        'W'  0x54  0x00  0x00
        'W'  0x55  0x00  0x00
        'W'  0x50  0x46  0x00
        'W'  0x51  0xD8  0x00
        'W'  0x56  0x23  0x00
        'W'  0x57  0xB4  0x00
        'W'  0x58  0x40  0x00
        'W'  0x59  0x0B  0x00
        'W'  0x5A  0x00  0x00
        'W'  0x5B  0x02  0x00
        'W'  0x5C  0x32  0x00
        'W'  0x5E  0x00  0x00
        'W'  0x5F  0x00  0x00
        'W'  0xC4  0x00  0x00

        'W'  0x03  0x01  0x65
        'W'  0x03  0x02  0xB5
        'W'  0x03  0x04  0x97
        'W'  0x03  0x08  0xA1

        'R'  0x4B  0x00  0x04
        'W'  0xAE  0x00  0x00
    >;
    pid_post_verify = <
        'R'  0x0A  0x33  0xFF
        'R'  0x0B  0x82  0xFF
        'R'  0x0E  0x88  0xFF
        'R'  0x0F  0xC1  0xFF
        'R'  0x08  0x1E  0xFF
        'R'  0x09  0x20  0xFF
        'R'  0x10  0x4B  0xFF
        'R'  0x11  0x52  0xFF
        'R'  0x12  0x8A  0xFF
        'R'  0x13  0x2B  0xFF
        'R'  0x14  0x0C  0xFF
        'R'  0x15  0x00  0xFF
        'R'  0x16  0x10  0xFF
        'R'  0x17  0x40  0xFF
        'R'  0x18  0xAA  0xFF
        'R'  0x1A  0x00  0xFF
        'R'  0x1B  0x66  0xFF
        'R'  0x1C  0xC9  0xFF
        'R'  0x1D  0xD8  0xFF
        'R'  0x1E  0xE9  0xFF
        'R'  0x1F  0x1E  0xFF
        'R'  0x20  0x1E  0xFF
        'R'  0x21  0x42  0xFF
        'R'  0x22  0xFB  0xFF
        'R'  0x23  0x05  0xFF
        'R'  0x24  0xF4  0xFF
        'R'  0x25  0xFE  0xFF
        'R'  0x26  0xC7  0xFF
        'R'  0x27  0xBA  0xFF
        'R'  0x28  0x77  0xFF
        'R'  0x29  0xE2  0xFF
        'R'  0x2A  0x39  0xFF
        'R'  0x2B  0xB9  0xFF
        'R'  0x2C  0x88  0xFF
        'R'  0x2D  0x1E  0xFF
        'R'  0x2E  0x3E  0xFF
        'R'  0x2F  0x8D  0xFF
        'R'  0x30  0x00  0xFF
        'R'  0x31  0x34  0xFF
        'R'  0x32  0x00  0xFF
        'R'  0x33  0xB4  0xFF
        'R'  0x34  0x00  0xFF
        'R'  0x35  0x96  0xFF
        'R'  0x36  0x00  0xFF
        'R'  0x3C  0x50  0xFF
        'R'  0x3D  0xCD  0xFF
        'R'  0x52  0x0F  0xFF
        'R'  0x53  0x64  0xFF
        'R'  0x54  0x00  0xFF
        'R'  0x55  0x00  0xFF
        'R'  0x50  0x46  0xFF
        'R'  0x51  0xD8  0xFF
        'R'  0x56  0x23  0xFF
        'R'  0x57  0xB4  0xFF
        'R'  0x58  0x40  0xFF
        'R'  0x59  0x0B  0xFF
        'R'  0x5A  0x00  0xFF
        'R'  0x5B  0x02  0xFF
        'R'  0x5C  0x32  0xFF
        'R'  0x5E  0x00  0xFF
        'R'  0x5F  0x00  0xFF
        'R'  0xC4  0x00  0xFF
    >;
    pid_settings_addr_type = <1>;
    pid_settings_data_type = <1>;
};