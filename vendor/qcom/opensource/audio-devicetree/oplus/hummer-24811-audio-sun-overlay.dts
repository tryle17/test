/dts-v1/;
/plugin/;
#include <dt-bindings/oplus/hw-id.h>
#include "../sun-audio-mtp-nfc.dts"
#include "sun-audio-overlay-common.dtsi"
#include "hummer-24811-audio-sun-overlay.dtsi"

/ {
    model = "Qualcomm Technologies, Inc. Sun MTP,hummer";

    oplus,project-id = <24811>;
};
